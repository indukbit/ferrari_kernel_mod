/* Copyright (c) 2014-2015, The Linux Foundation. All rights reserved.
 *
 * This program is free software; you can redistribute it and/or modify
 * it under the terms of the GNU General Public License version 2 and
 * only version 2 as published by the Free Software Foundation.
 *
 * This program is distributed in the hope that it will be useful,
 * but WITHOUT ANY WARRANTY; without even the implied warranty of
 * MERCHANTABILITY or FITNESS FOR A PARTICULAR PURPOSE.  See the
 * GNU General Public License for more details.
 */

&soc {
	spmi_bus: qcom,spmi@200f000 {
		qcom,pm8916@0 {
			pm8916_rtc: qcom,pm8916_rtc {
				qcom,qpnp-rtc-write = <1>;

				/* power-off alarm implementation is "wonky" at best */
				qcom,qpnp-rtc-alarm-pwrup = <0>;
			};
		};
	};
};
